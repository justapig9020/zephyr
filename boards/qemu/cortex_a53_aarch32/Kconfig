## boards/qemu/cortex_a53_aarch32/Kconfig
```kconfig
# Copyright (c) 2026 Realtek
# SPDX-License-Identifier: Apache-2.0

config BOARD_QEMU_CORTEX_A53_AARCH32
	select SOC_QEMU_CORTEX_A53_AARCH32
```

## boards/qemu/cortex_a53_aarch32/Kconfig.defconfig
```kconfig
# Copyright (c) 2026 Realtek
# SPDX-License-Identifier: Apache-2.0

if BOARD_QEMU_CORTEX_A53_AARCH32

config BUILD_WITH_TFA
	default y

config BUILD_OUTPUT_BIN
	default y

if QEMU_ICOUNT

config QEMU_ICOUNT_SHIFT
	default 4

config QEMU_ICOUNT_SLEEP
	default y

endif # QEMU_ICOUNT

endif # BOARD_QEMU_CORTEX_A53_AARCH32
```

## boards/qemu/cortex_a53_aarch32/qemu_cortex_a53_aarch32_defconfig
```kconfig
CONFIG_ARM_AARCH32_MMU=y
CONFIG_ARM_ARCH_TIMER=y

CONFIG_CACHE_MANAGEMENT=y

CONFIG_SERIAL=y
CONFIG_CONSOLE=y
CONFIG_UART_CONSOLE=y
CONFIG_UART_INTERRUPT_DRIVEN=y

CONFIG_QEMU_ICOUNT=y
```

## boards/qemu/cortex_a53_aarch32/qemu_cortex_a53_aarch32_qemu_cortex_a53_aarch32_smp_defconfig
```kconfig
CONFIG_ARM_AARCH32_MMU=y
CONFIG_ARM_ARCH_TIMER=y

CONFIG_CACHE_MANAGEMENT=y

CONFIG_SERIAL=y
CONFIG_CONSOLE=y
CONFIG_UART_CONSOLE=y
CONFIG_UART_INTERRUPT_DRIVEN=y

CONFIG_SOC_RESET_HOOK=y

CONFIG_QEMU_ICOUNT=n

CONFIG_PM_CPU_OPS=y
CONFIG_SMP=y
CONFIG_USE_SWITCH=y
CONFIG_MP_MAX_NUM_CPUS=2
CONFIG_TIMEOUT_64BIT=y
```

## soc/arm/qemu_cortex_a53_aarch32/Kconfig
```kconfig
# Copyright (c) 2026 Realtek
# SPDX-License-Identifier: Apache-2.0

config SOC_QEMU_CORTEX_A53_AARCH32
	select ARM
	select CPU_CORTEX_A53_AARCH32
	select ARMV8_A_NS
	select QEMU_TARGET
```

## tests/arch/arm/arm_fpu_smp/testcase.yaml
```yaml
common:
  tags:
    - arm
    - fpu
    - smp
  filter: CONFIG_SMP and CONFIG_FPU and not CONFIG_FPU_SHARING
tests:
  arch.arm.fpu_smp.unshared:
    platform_allow:
      - qemu_cortex_a53_aarch32/qemu_cortex_a53_aarch32/smp
```

## tests/kernel/fpu_sharing/smp/testcase.yaml
```yaml
common:
  tags:
    - fpu
    - kernel
    - smp
  platform_allow:
    - qemu_cortex_a53_aarch32/qemu_cortex_a53_aarch32/smp
  filter: CONFIG_SMP and CONFIG_FPU and CONFIG_SCHED_CPU_MASK and
          CONFIG_MP_MAX_NUM_CPUS > 1
tests:
  kernel.fpu_sharing.smp.per_cpu_unshared:
    extra_configs:
      - CONFIG_FPU_SHARING=n
  kernel.fpu_sharing.smp.shared_migration:
    extra_configs:
      - CONFIG_FPU_SHARING=y
```
