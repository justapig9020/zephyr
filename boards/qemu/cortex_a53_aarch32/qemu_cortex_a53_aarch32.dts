/*
 * Copyright (c) 2026 Realtek
 *
 * SPDX-License-Identifier: Apache-2.0
 */

/dts-v1/;

#include <arm/qemu/qemu-virt-a53-aarch32.dtsi>

/ {
	model = "QEMU Cortex-A53 AArch32";
	compatible = "qemu,arm-cortex-a53-aarch32";

	chosen {
		zephyr,sram = &sram0;
		zephyr,console = &uart0;
		zephyr,shell-uart = &uart0;
		zephyr,flash = &flash0;
	};
};

&uart0 {
	status = "okay";
	current-speed = <115200>;
};
